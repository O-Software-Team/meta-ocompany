## conf/layer.conf
```bitbake
# We have a conf and classes directory, append to BBPATH
BBPATH .= ":${LAYERDIR}"

# We have a recipes directory, add to BBFILES
BBFILES += "${LAYERDIR}/recipes-*/*/*.bb ${LAYERDIR}/recipes-*/*/*.bbappend"

BBFILE_COLLECTIONS += "ocompany-layer"
BBFILE_PATTERN_ocompany-layer := "^${LAYERDIR}/"
BBFILE_PRIORITY_ocompany-layer = "8"
LAYERSERIES_COMPAT_ocompany-layer = "warrior zeus"

LICENSE_PATH += "${LAYERDIR}/licenses"

BBMASK += "meta-imx/meta-bsp/recipes-connectivity/bluez5/bluez5_5.%.bbappend"

# The dynamic-layers directory hosts the extensions and layer specific
# modifications related to Ocompany Devices products.
#
# The .bbappend and .bb files are included (only) if the respective layer
# collection is available.
BBFILES += "${@' '.join('${LAYERDIR}/dynamic-layers/%s/recipes*/*/*.bbappend' % layer \
               for layer in BBFILE_COLLECTIONS.split())}"
BBFILES += "${@' '.join('${LAYERDIR}/dynamic-layers/%s/recipes*/*/*.bb' % layer \
               for layer in BBFILE_COLLECTIONS.split())}"
```

## conf/machine/odevice8mp.conf
```bitbake
#@TYPE: Machine
#@NAME: Ocompany odevice8MP
#@SOC: i.MX8 MP
#@DESCRIPTION: Machine configuration for Ocompany odevice8MP
#@MAINTAINER: Dan Fields <dfields@ocompany.io>

MACHINEOVERRIDES =. "mx8:mx8m:mx8mp:"

require conf/machine/include/imx-base.inc
require conf/machine/include/tune-cortexa53.inc

# Kernel configuration
PREFERRED_PROVIDER_virtual/kernel ??= "linux-ocompany"
KERNEL_DEVICETREE = "ocompany/imx8mp-odevice8mp.dtb \
	ocompany/imx8mp-odevice8mp-m4.dtb \
"
KERNEL_IMAGETYPE = "Image"
RDEPENDS_${KERNEL_PACKAGE_NAME}-base = ""

# U-Boot configuration
PREFERRED_PROVIDER_u-boot ??= "u-boot-ocompany"
PREFERRED_PROVIDER_virtual/bootloader ??= "u-boot-ocompany"
PREFERRED_PROVIDER_imx-atf ??= "imx-atf-ocompany"
SPL_BINARY = "spl/u-boot-spl.bin"
UBOOT_DTB_NAME ?= "imx8mp-odevice8mp.dtb"
UBOOT_MAKE_TARGET = ""
UBOOT_SUFFIX = "bin"
UBOOT_CONFIG ??= "sd"
UBOOT_CONFIG[sd] = "odevice8mp_2gr0_defconfig,sdcard"

IMAGE_BOOTLOADER = "imx-boot"

IMXBOOT_TARGETS = "flash_evk"

DDR_FIRMWARE_NAME = "\
    lpddr4_pmu_train_1d_imem_201904.bin \
    lpddr4_pmu_train_1d_dmem_201904.bin \
    lpddr4_pmu_train_2d_imem_201904.bin \
    lpddr4_pmu_train_2d_dmem_201904.bin \
"

# wic support
WKS_FILE = "sdimage-bootpart.wks"
IMAGE_BOOT_FILES_append = " \
	boot.scr-${MACHINE};boot.scr \
"
WKS_FILE_DEPENDS_mx8 += " \
	u-boot-script-ocompany \
	e2fsprogs-native \
	bmap-tools-native \
"
IMAGE_FSTYPES = "wic.bmap wic.gz tar.xz"

OPTEE_BIN_EXT = "8mp"

SERIAL_CONSOLES = "115200;ttymxc1"

MACHINE_FEATURES += " pci wifi bluetooth"
```
